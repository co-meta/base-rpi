## build/conf/bblayers.conf
```bitbake
# POKY_BBLAYERS_CONF_VERSION is increased each time build/conf/bblayers.conf
# changes incompatibly
POKY_BBLAYERS_CONF_VERSION = "2"

BBPATH = "${TOPDIR}"
BBFILES ?= ""

LAYERSDIR = "${@os.path.abspath(os.path.join("${TOPDIR}", os.pardir))}"

BBLAYERS ?= " \
  ${LAYERSDIR}/poky/meta \
  ${LAYERSDIR}/poky/meta-poky \
  ${LAYERSDIR}/poky/meta-yocto-bsp \
  ${LAYERSDIR}/meta-raspberrypi \
  "
BBLAYERS_NON_REMOVABLE ?= " \
  ${LAYERSDIR}/poky/meta \
  ${LAYERSDIR}/poky/meta-poky \
  ${LAYERSDIR}/poky/meta-yocto-bsp \
  "
```
